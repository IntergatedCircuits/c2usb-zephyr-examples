## west.yml
```yaml
# Copyright (c) 2021 Nordic Semiconductor ASA
# SPDX-License-Identifier: Apache-2.0

manifest:
  self:
    west-commands: scripts/west-commands.yml

  remotes:
    - name: zephyrproject-rtos
      url-base: https://github.com/zephyrproject-rtos
    - name: nrfconnect
      url-base: https://github.com/nrfconnect
    - name: IntergatedCircuits
      url-base: https://github.com/IntergatedCircuits

  projects:
    - name: c2usb
      remote: IntergatedCircuits
      revision: 02de130f755cca8872238bb98ab4dc44226d233f
      import: true

    - name: nrf
      repo-path: sdk-nrf
      remote: nrfconnect
      revision: v3.2.3
      clone-depth: 1
      import:
        # By using name-allowlist we can clone only the modules that are
        # strictly needed by the application.
        name-allowlist:
          - zephyr
          - cmsis_6
          - hal_nordic
          - nrfxlib
          - mbedtls
          - oberon-psa-crypto
```
