## CMakeLists.txt
```
# SPDX-License-Identifier: Apache-2.0

cmake_minimum_required(VERSION 3.20.0)
find_package(Zephyr REQUIRED HINTS $ENV{ZEPHYR_BASE})
project(usb-keyboard)

target_sources(app PRIVATE src/main.cpp)

# link the application to c2usb
target_link_libraries(app PRIVATE
    c2usb
    c2usb-example-hid
)
```

## sample.yaml
```
sample:
  name: USB HID keyboard sample
common:
  harness: button
  filter: dt_alias_exists("sw0") and dt_alias_exists("led0")
  depends_on:
    - gpio
  platform_allow:
    - nrf52840dk/nrf52840
```

## west.yml
```
../west.yml
```

## prj.conf
```kconfig
CONFIG_LOG=y
#CONFIG_UDC_DRIVER_LOG_LEVEL_INF=y
#CONFIG_C2USB_UDC_MAC_LOG_LEVEL_DBG=y

CONFIG_INPUT=y
CONFIG_INPUT_MODE_SYNCHRONOUS=y
CONFIG_HWINFO=y

CONFIG_C2USB_UDC_MAC=y
# RAM optimization:
# the buffer pool size can be cut down, as it's only used for control transfers
# CONFIG_UDC_BUF_POOL_SIZE=optimize based on your application (and check asserts)
# CONFIG_UDC_BUF_COUNT=3 + maximal used endpoint count in a configuration

# needed as at suspend the msgq is flooded otherwise
# CONFIG_C2USB_UDC_MAC_MSGQ_SIZE=32

CONFIG_DEBUG=y
CONFIG_DEBUG_OPTIMIZATIONS=y
CONFIG_DEBUG_THREAD_INFO=y

# don't use picolibc in debug builds as only its module version can print verbose assert() logs
# CONFIG_PICOLIBC_VERBOSE_ASSERT=y
# but that's conflicting with the chosen C++ standard library
CONFIG_NEWLIB_LIBC=y

CONFIG_USE_SEGGER_RTT=n
```

## src/main.cpp
```c
#include "iolib.h"
#include <zephyr/drivers/hwinfo.h>
#include <zephyr/input/input.h>
#include <zephyr/logging/log.h>

#include <port/zephyr/udc_mac.hpp>
#include <simple_keyboard.hpp>
#include <usb/df/class/hid.hpp>
#include <usb/df/device.hpp>
#include <zephyr/message_queue.hpp>

LOG_MODULE_REGISTER(main, LOG_LEVEL_INF);

using namespace magic_enum::bitwise_operators;

auto& kb_msgq()
{
    static zephyr::message_queue_instance<input_event, 2> msgq;
    return msgq;
}

static void input_cb(input_event* evt, void*)
{
    kb_msgq().post(*evt);
}

INPUT_CALLBACK_DEFINE(nullptr, input_cb, nullptr);

auto& keyboard_app()
{
    static simple_keyboard<> keyb{[](const simple_keyboard<>::kb_leds_report& report)
                                  {
                                      iolib_set_led(0,
                                                    report.leds.test(hid::page::leds::CAPS_LOCK));
                                  }};
    return keyb;
}

static uint8_t serial_number[16]{};
constexpr usb::product_info product_info{CONFIG_DEMO_MANUFACTURER_ID, CONFIG_DEMO_MANUFACTURER,
                                         CONFIG_DEMO_PRODUCT_ID,      CONFIG_DEMO_PRODUCT,
                                         usb::version("1.0"),         serial_number};

auto& mac()
{
    static usb::zephyr::udc_mac mac{DEVICE_DT_GET(DT_NODELABEL(zephyr_udc0))};
    return mac;
}

auto& device()
{
    static usb::df::device_instance<usb::speed::FULL> device{mac(), product_info};
    return device;
}

//[[noreturn]]
int main(void)
{
    // observing device state
    device().set_power_event_delegate(
        [](usb::df::device& dev, usb::df::device::event ev)
        {
            if (ev == usb::df::device::event::CONFIGURATION_CHANGE)
            {
                LOG_INF("USB configured: %u, granted current: %uuA", (unsigned)dev.configured(),
                        dev.granted_bus_current_uA());
            }
            else
            {
                LOG_INF("USB power state: %s, granted current: %uuA",
                        magic_enum::enum_name(dev.power_state()).data(),
                        dev.granted_bus_current_uA());
            }
        });

    // use HW info as serial number
    if (IS_ENABLED(CONFIG_HWINFO))
    {
        hwinfo_get_device_id(serial_number, sizeof(serial_number));
    }
    // define configuration and start device
    {
        constexpr auto speed = usb::speed::FULL;
        constexpr auto config_header = usb::df::config::header(
            usb::df::config::power::bus(500, true), "base config but make it longer.");

        static usb::df::hid::function usb_kb{keyboard_app(), "keyboard",
                                             usb::hid::boot_protocol_mode::KEYBOARD};

        static const auto base_config = usb::df::config::make_config(
            config_header, usb::df::hid::config(usb_kb, speed, usb::endpoint::address(0x81), 1
#if 0
            , usb::endpoint::address(0x01), 10
#endif
                                                ));
        device().set_config(base_config);
        device().open();
    }

    while (true)
    {
        auto msg = kb_msgq().get();
        if ((msg.value) && device().power_state() == usb::power::state::L2_SUSPEND)
        {
            device().remote_wakeup();
        }
        switch (msg.code)
        {
        case INPUT_KEY_0:
            keyboard_app().send_key(hid::page::keyboard_keypad::KEYBOARD_CAPS_LOCK, msg.value);
            break;
        case INPUT_KEY_1:
            keyboard_app().send_key(hid::page::keyboard_keypad::KEYBOARD_BACKSLASH_PIPE, msg.value);
            break;
        case INPUT_KEY_2:
            keyboard_app().send_key(hid::page::keyboard_keypad::KEYBOARD_ENTER, msg.value);
            break;
        case INPUT_KEY_3:
            keyboard_app().send_key(hid::page::keyboard_keypad::KEYBOARD_F1, msg.value);
            break;
        default:
            break;
        }
    }
}
```
