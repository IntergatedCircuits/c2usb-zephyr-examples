## CMakeLists.txt
```
# SPDX-License-Identifier: Apache-2.0

cmake_minimum_required(VERSION 3.20.0)
find_package(Zephyr REQUIRED HINTS $ENV{ZEPHYR_BASE})
project(usb-shell)

target_include_directories(app PRIVATE
    src
)
target_sources(app PRIVATE
    src/main.cpp
)

# link the application to c2usb
target_link_libraries(app PRIVATE
    c2usb
)
```

## sample.yaml
```
sample:
  name: USB HID/XINPUT gamepad sample
common:
  harness: button
  filter: dt_alias_exists("sw0") and dt_alias_exists("sw1") and dt_alias_exists("sw2") and dt_alias_exists("led0")
  depends_on:
    - gpio
  platform_allow:
    - nrf52840dk/nrf52840
```

## prj.conf
```kconfig
CONFIG_LOG=y
CONFIG_UDC_DRIVER_LOG_LEVEL_WRN=y
#CONFIG_C2USB_UDC_MAC_LOG_LEVEL_DBG=y

CONFIG_HWINFO=y

CONFIG_SHELL=y
CONFIG_SHELL_BACKEND_C2USB=y
CONFIG_SHELL_BACKEND_SERIAL=n
CONFIG_SHELL_LOG_BACKEND=y
CONFIG_SHELL_MINIMAL=n
# needs to be ~100 bytes more than default
CONFIG_SHELL_STACK_SIZE=1536

CONFIG_C2USB_UDC_MAC=y
# RAM optimization:
# the buffer pool size can be cut down, as it's only used for control transfers
# CONFIG_UDC_BUF_POOL_SIZE=optimize based on your application (and check asserts)
# CONFIG_UDC_BUF_COUNT=3 + maximal used endpoint count in a configuration

# needed as at suspend the msgq is flooded otherwise
# CONFIG_C2USB_UDC_MAC_MSGQ_SIZE=32

CONFIG_DEBUG=y
CONFIG_DEBUG_OPTIMIZATIONS=y
CONFIG_DEBUG_THREAD_INFO=y

# don't use picolibc in debug builds as only its module version can print verbose assert() logs
# CONFIG_PICOLIBC_VERBOSE_ASSERT=y
# but that's conflicting with the chosen C++ standard library
CONFIG_NEWLIB_LIBC=y

CONFIG_USE_SEGGER_RTT=n
```

## src/main.cpp
```c
#include <zephyr/drivers/hwinfo.h>
#include <zephyr/logging/log.h>
#include <zephyr/shell/shell.h>

#include <hid/app/mouse.hpp>
#include <hid/application.hpp>
#include <magic_enum.hpp>
#include <port/zephyr/udc_mac.hpp>
#include <port/zephyr/usb_shell.hpp>
#include <usb/df/device.hpp>

LOG_MODULE_REGISTER(main, LOG_LEVEL_INF);

static uint8_t serial_number[16]{};
constexpr usb::product_info product_info{CONFIG_DEMO_MANUFACTURER_ID, CONFIG_DEMO_MANUFACTURER,
                                         CONFIG_DEMO_PRODUCT_ID,      CONFIG_DEMO_PRODUCT,
                                         usb::version("1.0"),         serial_number};

auto& mac()
{
    static usb::zephyr::udc_mac mac{DEVICE_DT_GET(DT_NODELABEL(zephyr_udc0))};
    return mac;
}

auto& device()
{
    static usb::df::device_instance<usb::speed::FULL> device{mac(), product_info};
    return device;
}

//[[noreturn]]
int main(void)
{
    // observing device state
    device().set_power_event_delegate(
        [](usb::df::device& dev, usb::df::device::event ev)
        {
            using event = enum usb::df::device::event;
            if (ev == event::CONFIGURATION_CHANGE)
            {
                LOG_INF("USB configured: %u, granted current: %uuA", (unsigned)dev.configured(),
                        dev.granted_bus_current_uA());
            }
            else
            {
                LOG_INF("USB power state: %s, granted current: %uuA",
                        magic_enum::enum_name(dev.power_state()).data(),
                        dev.granted_bus_current_uA());
            }
        });

    // use HW info as serial number
    if (IS_ENABLED(CONFIG_HWINFO))
    {
        hwinfo_get_device_id(serial_number, sizeof(serial_number));
    }
    // define configuration and start device
    {
        constexpr auto speed = usb::speed::FULL;
        constexpr auto config_header =
            usb::df::config::header(usb::df::config::power::bus(500, true), "base config");

        static const auto base_config = usb::df::config::make_config(
            config_header,
            usb::df::cdc::config(
                usb::zephyr::usb_shell::handle(), speed, usb::endpoint::address(0x01),
                usb::endpoint::address(0x81),
                usb::endpoint::address(0x82) // note that notification endpoint is unused here
                ));
        device().set_config(base_config);
        device().open();
    }

    while (true)
    {
        k_sleep(K_FOREVER);
    }
}
```
