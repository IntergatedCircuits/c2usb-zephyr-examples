## CMakeLists.txt
```
# SPDX-License-Identifier: Apache-2.0

cmake_minimum_required(VERSION 3.20.0)
find_package(Zephyr REQUIRED HINTS $ENV{ZEPHYR_BASE})
project(ble-keyboard)

target_sources(app PRIVATE src/main.cpp)

# link the application to c2usb
target_link_libraries(app PRIVATE
    c2usb
    c2usb-example-hid
)
```

## Kconfig
```
rsource "../Kconfig"

configdefault BT_DIS_MANUF_NAME
	default y

configdefault BT_DIS_MANUF_NAME_STR
	default DEMO_MANUFACTURER

configdefault BT_DIS_MODEL_NUMBER
	default y

configdefault BT_DIS_MODEL_NUMBER_STR
	default DEMO_PRODUCT

configdefault BT_DIS_PNP
	default y

configdefault BT_DIS_PNP_VID
	default DEMO_MANUFACTURER_ID

configdefault BT_DIS_PNP_PID
	default DEMO_PRODUCT_ID

menu "BLE Keyboard sample"

config SETTINGS
	default y

config ZMS
	default y if SOC_FLASH_NRF_RRAM

config NVS
	default y if !SOC_FLASH_NRF_RRAM

endmenu

source "Kconfig.zephyr"
```

## sample.yaml
```
sample:
  name: BLE HID keyboard sample
common:
  harness: button
  filter: dt_alias_exists("sw0") and dt_alias_exists("led0")
  depends_on:
    - gpio
  platform_allow:
    - nrf52840dk/nrf52840
```

## prj.conf
```kconfig
# Increased stack due to settings API usage
CONFIG_SYSTEM_WORKQUEUE_STACK_SIZE=2048

CONFIG_BT=y
CONFIG_LOG=y
CONFIG_BT_SMP=y
CONFIG_BT_PERIPHERAL=y
CONFIG_BT_DIS=y
CONFIG_BT_DIS_SERIAL_NUMBER=y
CONFIG_BT_BAS=y
CONFIG_BT_DEVICE_NAME="c2usb keyboard"
CONFIG_BT_DEVICE_APPEARANCE=961
CONFIG_BT_MAX_CONN=2
CONFIG_BT_MAX_PAIRED=10
CONFIG_BT_KEYS_OVERWRITE_OLDEST=y
CONFIG_BT_KEYS_SAVE_AGING_COUNTER_ON_PAIRING=y
CONFIG_BT_ID_UNPAIR_MATCHING_BONDS=y

CONFIG_BT_SETTINGS=y
CONFIG_FLASH=y
CONFIG_FLASH_PAGE_LAYOUT=y
CONFIG_FLASH_MAP=y

CONFIG_BT_GAP_AUTO_UPDATE_CONN_PARAMS=y
# for an input device keep it low, lowest allowed is 6 (7.5ms), lowest supported widely is 9 (11.25ms)
CONFIG_BT_PERIPHERAL_PREF_MIN_INT=9
CONFIG_BT_PERIPHERAL_PREF_MAX_INT=9

#CONFIG_BT_LL_SOFTDEVICE=y

CONFIG_SHELL=y
CONFIG_SHELL_MINIMAL=y
CONFIG_SHELL_STACK_SIZE=1024
CONFIG_SHELL_BACKEND_SERIAL=y

CONFIG_INPUT=y
CONFIG_INPUT_MODE_SYNCHRONOUS=y
CONFIG_HWINFO=y

CONFIG_C2USB_BLUETOOTH=y
#CONFIG_C2USB_HOGP_LOG_LEVEL_DBG=y

CONFIG_ASSERT=y
CONFIG_ASSERT_NO_COND_INFO=y
CONFIG_ASSERT_NO_MSG_INFO=y

CONFIG_DEBUG=y
CONFIG_DEBUG_OPTIMIZATIONS=y
CONFIG_DEBUG_THREAD_INFO=y

# don't use picolibc in debug builds as only its module version can print verbose assert() logs
# CONFIG_PICOLIBC_VERBOSE_ASSERT=y
# but that's conflicting with the chosen C++ standard library
CONFIG_NEWLIB_LIBC=y

CONFIG_USE_SEGGER_RTT=n

# Disable automatic initiation of PHY updates and the SMP Security Requests.
# Workaround to prevent disconnection with the following disconnect reasons:
# - 0x08 (BT_HCI_ERR_CONN_TIMEOUT)
# - 0x13 (BT_HCI_ERR_REMOTE_USER_TERM_CONN)
# - 0x23 (BT_HCI_ERR_LL_PROC_COLLISION)
# - 0x2A (BT_HCI_ERR_DIFF_TRANS_COLLISION)
# Some laptop Bluetooth controllers may simultaneously trigger two Link Layer
# procedures which results in a procedure collision and disconnection.
CONFIG_BT_GATT_AUTO_SEC_REQ=n
CONFIG_BT_AUTO_PHY_UPDATE=n

CONFIG_SHELL_STACK_SIZE=2048
```

## src/main.cpp
```c
#include "iolib.h"
#include <zephyr/bluetooth/bluetooth.h>
#include <zephyr/bluetooth/hci.h>
#include <zephyr/bluetooth/services/bas.h>
#include <zephyr/drivers/hwinfo.h>
#include <zephyr/input/input.h>
#include <zephyr/kernel.h>
#include <zephyr/logging/log.h>
#include <zephyr/settings/settings.h>
#include <zephyr/shell/shell.h>

#include "simple_keyboard.hpp"
#include <port/zephyr/bluetooth/hid.hpp>
#include <port/zephyr/bluetooth/le.hpp>
#include <raw_to_hex_string.hpp>
#include <usb/df/message.hpp>
#include <zephyr/message_queue.hpp>

LOG_MODULE_REGISTER(main, LOG_LEVEL_INF);

static const uint8_t adv_led = 1;

static int advertise(void)
{
    using namespace bluetooth::zephyr;

    static constexpr auto ad_data =
        join(ad_struct<std::uint16_t>(BT_DATA_GAP_APPEARANCE, CONFIG_BT_DEVICE_APPEARANCE),
             ad_struct<std::uint8_t>(BT_DATA_FLAGS, BT_LE_AD_GENERAL | BT_LE_AD_NO_BREDR),
             ad_struct<std::uint16_t>(BT_DATA_UUID16_ALL, {BT_UUID_HIDS_VAL, BT_UUID_BAS_VAL}));
    static constexpr auto ad = to_adv_data<ad_struct_count(ad_data)>(ad_data);
    static constexpr auto sd_data = join(ad_struct(BT_DATA_NAME_COMPLETE, CONFIG_BT_DEVICE_NAME));
    static constexpr auto sd = to_adv_data<ad_struct_count(sd_data)>(sd_data);
    const bt_le_adv_param* adv_param = BT_LE_ADV_PARAM(
        BT_LE_ADV_OPT_CONN, BT_GAP_ADV_FAST_INT_MIN_2, BT_GAP_ADV_FAST_INT_MAX_2, nullptr);

    auto err = bt_le_adv_start(adv_param, ad.data(), ad.size(), sd.data(), sd.size());
    if (err == 0)
    {
        iolib_set_led(adv_led, true);
        LOG_INF("Advertising successfully started\n");
    }
    else if (err == -EALREADY)
    {
        LOG_INF("Advertising continued\n");
    }
    else
    {
        LOG_WRN("Advertising failed to start (err %d)\n", err);
    }
    return err;
}

auto& pairing_msgq()
{
    static zephyr::message_queue_instance<::bt_conn*, CONFIG_BT_MAX_CONN> msgq;
    return msgq;
}

static void connected(bt_conn* conn, uint8_t err)
{
    bluetooth::zephyr::address_str addr{conn};

    if (err)
    {
        LOG_WRN("Failed to connect to %s 0x%02x %s\n", addr.data(), err, bt_hci_err_to_str(err));
        return;
    }
    LOG_INF("Connected %s\n", addr.data());

    if (!advertise())
    {
        iolib_set_led(adv_led, false);
    }
}

static void disconnected(bt_conn* conn, uint8_t reason)
{
    bluetooth::zephyr::address_str addr{conn};

    LOG_INF("Disconnected from %s, reason 0x%02x %s\n", addr.data(), reason,
            bt_hci_err_to_str(reason));

    advertise();
}

static void security_changed(bt_conn* conn, bt_security_t level, bt_security_err err)
{
    bluetooth::zephyr::address_str addr{conn};

    if (!err)
    {
        LOG_INF("Security changed: %s level %u\n", addr.data(), level);
    }
    else
    {
        LOG_WRN("Security failed: %s level %u err %d %s\n", addr.data(), level, err,
                bt_security_err_to_str(err));
    }
}

static void le_param_updated(bt_conn* conn, uint16_t interval, uint16_t latency, uint16_t timeout);

BT_CONN_CB_DEFINE(conn_callbacks) = {
    .connected = connected,
    .disconnected = disconnected,
    .le_param_updated = le_param_updated,
    .security_changed = security_changed,
};

static void auth_passkey_entry(bt_conn* conn)
{
    bluetooth::zephyr::address_str addr{conn};
    LOG_INF("Passkey requested for %s, type `bt passkey XXXXXX` to complete\n", addr.data());
    if (!pairing_msgq().try_post(bt_conn_ref(conn)))
    {
        LOG_WRN("Pairing queue full\n");
    }
}

static void auth_cancel(bt_conn* conn)
{
    bluetooth::zephyr::address_str addr{conn};
    LOG_INF("Pairing cancelled: %s\n", addr.data());
}

static const bt_conn_auth_cb conn_auth_callbacks = {.passkey_entry = auth_passkey_entry,
                                                    .cancel = auth_cancel};

static void pairing_complete(bt_conn* conn, bool bonded)
{
    bluetooth::zephyr::address_str addr{conn};
    LOG_INF("Pairing completed: %s, bonded: %d\n", addr.data(), bonded);
}

static void pairing_failed(bt_conn* conn, bt_security_err reason)
{
    bluetooth::zephyr::address_str addr{conn};
    LOG_INF("Pairing failed conn: %s, reason %d %s\n", addr.data(), reason,
            bt_security_err_to_str(reason));

    auto pairing = pairing_msgq().peek();
    if (pairing && pairing.value() == conn)
    {
        bt_conn_unref(conn);
        pairing_msgq().try_get();
    }
}

static bt_conn_auth_info_cb conn_auth_info_callbacks = {.pairing_complete = pairing_complete,
                                                        .pairing_failed = pairing_failed};

static void pairing_reply(int passkey)
{
    auto pairing = pairing_msgq().try_get();
    if (!pairing)
    {
        return;
    }
    if (passkey < 0)
    {
        bt_conn_auth_cancel(pairing.value());
    }
    else
    {
        bt_conn_auth_passkey_entry(pairing.value(), passkey);
    }

    bt_conn_unref(pairing.value());
}

static int cmd_bt_passkey(const shell* sh, size_t argc, char** argv)
{
    int err = 0;
    int passkey = shell_strtol(argv[1], 10, &err);
    if (err)
    {
        shell_error(sh, "Invalid passkey %d", err);
    }
    else
    {
        pairing_reply(passkey);
    }
    return 0;
}

static int cmd_bt_battery(const shell* sh, size_t argc, char** argv)
{
    int err{};
    auto battery_level = shell_strtoul(argv[1], 10, &err);
    if (err)
    {
        shell_error(sh, "Invalid battery level %d", err);
    }
    else
    {
        bt_bas_set_battery_level(battery_level);
    }
    return 0;
}

SHELL_STATIC_SUBCMD_SET_CREATE(
    sub_bt, SHELL_CMD_ARG(passkey, NULL, "Send BT pairing passkey", cmd_bt_passkey, 2, 0),
    SHELL_CMD_ARG(battery, NULL, "Update battery level to BT central", cmd_bt_battery, 2, 0),
    SHELL_SUBCMD_SET_END);
SHELL_CMD_REGISTER(bt, &sub_bt, "BT", NULL);

auto& keyboard_app()
{
    static simple_keyboard<> keyb{[](const simple_keyboard<>::kb_leds_report& report)
                                  {
                                      iolib_set_led(0,
                                                    report.leds.test(hid::page::leds::CAPS_LOCK));
                                  }};
    return keyb;
}

static auto& hog_service()
{
    using namespace magic_enum::bitwise_operators;
    using namespace bluetooth::zephyr::hid;

    // TODO: set values as needed
    static const auto security = security::ENCRYPT;
    static const auto features = flags::NORMALLY_CONNECTABLE | flags::REMOTE_WAKE;

    static service_instance<hid::app::keyboard::app_report_descriptor<0>(),
                            boot_protocol_mode::KEYBOARD>
        hog{keyboard_app(), security, features};
    return hog;
}

auto& kb_msgq()
{
    static zephyr::message_queue_instance<input_event, 2> msgq;
    return msgq;
}

static void input_cb(input_event* evt, void*)
{
    kb_msgq().post(*evt);
}

INPUT_CALLBACK_DEFINE(nullptr, input_cb, nullptr);

#if CONFIG_BT_GAP_PERIPHERAL_PREF_PARAMS
static_assert((10 * CONFIG_BT_PERIPHERAL_PREF_TIMEOUT) >
                  ((1 + CONFIG_BT_PERIPHERAL_PREF_LATENCY) * 2 *
                   (CONFIG_BT_PERIPHERAL_PREF_MAX_INT * 5 / 4)),
              "The peripheral preferred connection parameters are not valid");
#endif
static void le_param_updated(bt_conn* conn, uint16_t interval, uint16_t latency, uint16_t timeout)
{
    if (conn != hog_service().peer())
    {
        return;
    }
    LOG_INF("BLE HID conn params: interval=%u ms, latency=%u, timeout=%u ms\n", interval * 5 / 4,
            latency, timeout * 10);
}

char serial_number_str[33];

int main(void)
{
    // use HW info as serial number
    if (IS_ENABLED(CONFIG_HWINFO))
    {
        uint8_t serial_number[16]{};
        auto n = hwinfo_get_device_id(serial_number, sizeof(serial_number));
        c2usb::raw_to_hex_string(std::span<const uint8_t>(serial_number, n),
                                 std::span<char>(serial_number_str));
    }
    if (auto err = bt_conn_auth_cb_register(&conn_auth_callbacks); err)
    {
        LOG_ERR("Failed to register authorization callbacks.\n");
        return 0;
    }
    if (auto err = bt_conn_auth_info_cb_register(&conn_auth_info_callbacks); err)
    {
        LOG_ERR("Failed to register authorization info callbacks.\n");
        return 0;
    }
    if (!hog_service().start())
    {
        LOG_ERR("HID service initialization failed\n");
        return 0;
    }
    if (auto err = bt_enable(nullptr); err)
    {
        LOG_ERR("Bluetooth init failed (err %d)\n", err);
        return 0;
    }
    if (IS_ENABLED(CONFIG_SETTINGS))
    {
        settings_load();
    }
    advertise();

    while (true)
    {
        auto msg = kb_msgq().get();
        switch (msg.code)
        {
        case INPUT_KEY_0:
            keyboard_app().send_key(hid::page::keyboard_keypad::KEYBOARD_CAPS_LOCK, msg.value);
            break;
        default:
            break;
        }
    }
}
```
